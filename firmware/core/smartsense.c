#include "smartsense.h"

static const float cs[20] = {
    1.0f,.951056516f,.809016994f,.587785252f,.309016994f,0.0f,
    -.309016994f,-.587785252f,-.809016994f,-.951056516f,-1.0f,
    -.951056516f,-.809016994f,-.587785252f,-.309016994f,0.0f,
    .309016994f,.587785252f,.809016994f,.951056516f
};
static const float sn[20] = {
    0.0f,.309016994f,.587785252f,.809016994f,.951056516f,1.0f,
    .951056516f,.809016994f,.587785252f,.309016994f,0.0f,
    -.309016994f,-.587785252f,-.809016994f,-.951056516f,-1.0f,
    -.951056516f,-.809016994f,-.587785252f,-.309016994f
};
static int finite_float(float x) { return x >= -3.4028234e38f && x <= 3.4028234e38f; }
static float root(float x) { return __builtin_sqrtf(x); }

int ss_ir_block(const uint16_t *adc, size_t count, size_t stride,
                float vref, ss_measurement *out)
{
    if (!out) return SS_BAD_INPUT;
    out->amplitude_v = out->offset_v = out->residual_rms_v = 0.0f;
    out->quality = SS_BAD_INPUT;
    if (!adc || count < 20 || count > 2000 || count % 20 != 0 ||
        stride < 1 || stride > 16 || !finite_float(vref) || vref < 3.0f || vref > 3.6f)
        return out->quality;
    float sum = 0.0f, re = 0.0f, im = 0.0f;
    const float scale = vref / 4095.0f;
    int clipped = 0;
    for (size_t i = 0; i < count; ++i) {
        uint16_t raw = adc[i * stride];
        if (raw > 4095) return out->quality;
        if (raw <= 8 || raw >= 4087) clipped = 1;
        float v = raw * scale;
        sum += v; re += v * cs[i % 20]; im += v * sn[i % 20];
    }
    float mean = sum / (float)count;
    re *= 2.0f / (float)count; im *= 2.0f / (float)count;
    float residual = 0.0f;
    for (size_t i = 0; i < count; ++i) {
        float error = adc[i * stride] * scale - mean - re * cs[i % 20] - im * sn[i % 20];
        residual += error * error;
    }
    out->amplitude_v = root(re * re + im * im);
    out->offset_v = mean;
    out->residual_rms_v = root(residual / (float)count);
    out->quality = clipped ? SS_CLIPPED : SS_VALID;
    return out->quality;
}

void ss_observer_reset(ss_observer *o)
{
    if (!o) return;
    o->x[0] = o->x[1] = 0.0f; o->x[2] = 1.65f; o->samples = 0;
}

int ss_observer_step(ss_observer *o, float adc_volts, float vref)
{
    if (!o) return 0;
    if (!finite_float(adc_volts) || !finite_float(vref) || vref < 3.0f || vref > 3.6f ||
        adc_volts <= vref * (8.0f / 4095.0f) || adc_volts >= vref * (4087.0f / 4095.0f)) {
        ss_observer_reset(o); return 0;
    }
    /* Harmonic signal + DC bias, y=x1+x3. Generated by etudes/observateur_ir.m.
       This estimates signal components, not the unmeasured internal filter states. */
    float e = adc_volts - o->x[0] - o->x[2];
    float a = .951056516f * o->x[0] - .309016994f * o->x[1] + .00951530977f * e;
    float b = .309016994f * o->x[0] + .951056516f * o->x[1] + .00297773994f * e;
    float bias = o->x[2] + .000995255397f * e;
    if (!finite_float(a) || !finite_float(b) || !finite_float(bias)) {
        ss_observer_reset(o); return 0;
    }
    o->x[0] = a; o->x[1] = b; o->x[2] = bias;
    if (o->samples < 2000) ++o->samples;
    return 1;
}

int ss_observer_read(const ss_observer *o, float *amplitude_v, float *offset_v)
{
    if (!o || !amplitude_v || !offset_v) return 0;
    *amplitude_v = *offset_v = 0.0f;
    if (o->samples < 2000) return 0;
    *amplitude_v = root(o->x[0] * o->x[0] + o->x[1] * o->x[1]);
    *offset_v = o->x[2]; return 1;
}

void ss_detector_reset(ss_detector *d)
{
    if (!d) return;
    d->threshold_low_v = d->threshold_high_v = 0.0f;
    d->last_ms = d->seen = d->calibrated = d->candidate_count = 0;
    d->state = d->candidate = SS_UNCALIBRATED;
}

int ss_detector_calibrate(ss_detector *d, float clear_v, float blocked_v, float sigma_v)
{
    if (!d) return 0;
    ss_detector_reset(d);
    if (!finite_float(clear_v) || !finite_float(blocked_v) || !finite_float(sigma_v) ||
        clear_v > 1.5f || blocked_v < 0.0f || sigma_v < 0.0f) return 0;
    float gap = clear_v - blocked_v;
    if (gap < 0.02f || gap < 6.0f * sigma_v) return 0;
    d->threshold_low_v = blocked_v + .4f * gap;
    d->threshold_high_v = blocked_v + .6f * gap;
    d->calibrated = 1; d->state = SS_SETTLING; return 1;
}

int ss_detector_update(ss_detector *d, const ss_measurement *m, uint32_t sample_ms)
{
    if (!d) return SS_INVALID;
    if (!m || m->quality != SS_VALID || !finite_float(m->amplitude_v) ||
        !finite_float(m->offset_v) || !finite_float(m->residual_rms_v) ||
        m->amplitude_v < 0.0f || m->amplitude_v > 3.6f ||
        m->offset_v < 0.0f || m->offset_v > 3.6f || m->residual_rms_v < 0.0f) {
        d->state = m && m->quality == SS_CLIPPED ? SS_SATURATED : SS_INVALID;
        d->candidate_count = 0; d->seen = 0; return d->state;
    }
    if (d->seen) {
        uint32_t elapsed = sample_ms - d->last_ms;
        if (elapsed == 0 || elapsed >= UINT32_C(0x80000000)) {
            d->state = SS_INVALID; d->candidate_count = 0; d->seen = 0; return d->state;
        }
        if (elapsed >= 100) { d->state = SS_SETTLING; d->candidate_count = 0; }
    }
    d->last_ms = sample_ms; d->seen = 1;
    if (!d->calibrated) return d->state = SS_UNCALIBRATED;
    int wanted = m->amplitude_v >= d->threshold_high_v ? SS_CLEAR :
                 m->amplitude_v <= d->threshold_low_v ? SS_LOW_SIGNAL : d->state;
    if (wanted != SS_CLEAR && wanted != SS_LOW_SIGNAL) {
        d->candidate_count = 0; return d->state;
    }
    if (wanted != d->candidate) { d->candidate = wanted; d->candidate_count = 0; }
    if (d->candidate_count < 3) ++d->candidate_count;
    if (d->candidate_count >= 3) d->state = wanted;
    else if (d->state != SS_CLEAR && d->state != SS_LOW_SIGNAL) d->state = SS_SETTLING;
    return d->state;
}

int ss_detector_status(ss_detector *d, uint32_t now_ms)
{
    if (!d) return SS_INVALID;
    if (!d->seen) return d->state;
    if (now_ms - d->last_ms >= 100) {
        d->state = SS_STALE; d->candidate_count = 0;
    }
    return d->state;
}

void ss_rt_reset(ss_rt_guard *g, uint32_t now_us)
{
    if (!g) return;
    g->last_block = g->last_completed_us = g->started_us = 0;
    g->last_valid_us = now_us;
    g->have_sequence = g->have_valid = g->pending = g->lost_blocks = 0;
    g->fault = SS_RT_OK;
}

int ss_rt_begin(ss_rt_guard *g, uint32_t block_id, uint32_t completed_us, uint32_t now_us)
{
    if (!g) return SS_RT_API_ERROR;
    if (g->pending) { g->pending = 0; return g->fault = SS_RT_API_ERROR; }
    if (now_us - completed_us > 1000) return g->fault = SS_RT_LATE;
    if (g->have_sequence) {
        uint32_t blocks = block_id - g->last_block;
        uint32_t period = completed_us - g->last_completed_us;
        if (blocks == 0 || blocks >= UINT32_C(0x80000000))
            return g->fault = SS_RT_SEQUENCE;
        g->last_block = block_id; g->last_completed_us = completed_us;
        if (blocks != 1) {
            uint32_t lost = blocks - 1;
            g->lost_blocks = UINT32_MAX - g->lost_blocks < lost ? UINT32_MAX : g->lost_blocks + lost;
            return g->fault = SS_RT_LOSS;
        }
        if (period < 1900 || period > 2100) return g->fault = SS_RT_CADENCE;
    } else {
        g->have_sequence = 1; g->last_block = block_id; g->last_completed_us = completed_us;
    }
    g->started_us = now_us; g->pending = 1;
    return SS_RT_OK;
}

int ss_rt_finish(ss_rt_guard *g, uint32_t now_us)
{
    if (!g) return SS_RT_API_ERROR;
    if (!g->pending) return g->fault = SS_RT_API_ERROR;
    g->pending = 0;
    if (now_us - g->started_us > 1000 || now_us - g->last_completed_us >= 2000)
        return g->fault = SS_RT_DEADLINE;
    g->last_valid_us = g->last_completed_us; g->have_valid = 1;
    return g->fault = SS_RT_OK;
}

int ss_rt_status(ss_rt_guard *g, uint32_t now_us)
{
    if (!g) return SS_RT_API_ERROR;
    if (g->fault != SS_RT_OK) return g->fault;
    if (now_us - g->last_valid_us >= 100000) return g->fault = SS_RT_STALE;
    return g->have_valid ? SS_RT_OK : SS_RT_WAITING;
}

void ss_rt_acquisition_fault(ss_rt_guard *g)
{
    if (!g) return;
    g->pending = 0; g->fault = SS_RT_ACQUISITION;
}
